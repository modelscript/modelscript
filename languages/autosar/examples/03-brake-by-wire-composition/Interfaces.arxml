AUTOSAR XML
package /BbwInterfaces
  sender receiver interface PedalForceIf
    data PedalForceN
  sender receiver interface BrakeTorqueIf
    data TargetTorqueNm
