AUTOSAR XML
package /BbwComponents
  application sw component type PedalSensorSwc
    provide port PedalForceOut: provided-interface=PedalForceIf
    behavior PedalSensor_IB
      runnable RE_AcquirePedal: execution-time-wcet=0.0010
      timing event TE_Pedal_5ms: start-on-event=RE_AcquirePedal, period=0.005
