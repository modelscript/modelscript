AUTOSAR XML
package /BbwComposition
  composition sw component type BrakeByWireSystem
    component PedalSensor: type=PedalSensorSwc
    component BrakeCtrl: type=BrakeCtrlSwc
    connect {context-component=PedalSensor, target-p-port=PedalForceOut} -> {context-component=BrakeCtrl, target-r-port=PedalForceIn}
