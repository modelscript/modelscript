AUTOSAR XML
package /AccSystem
  composition sw component type AccVehicleComposition
    component FrontRadar: type=RadarTrackerSwc
    component AccCtrl: type=AccControllerSwc
    connect {context-component=FrontRadar, target-p-port=TrackOut} -> {context-component=AccCtrl, target-r-port=TrackIn}
