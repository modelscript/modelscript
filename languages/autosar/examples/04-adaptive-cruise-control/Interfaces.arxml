AUTOSAR XML
package /AccInterfaces
  sender receiver interface RadarTrackIf
    data TargetRangeM
    data RelVelocityMs
  client server interface DecelRequestIf
    operation RequestDeceleration
