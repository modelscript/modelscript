AUTOSAR XML
package /EvComCanFd
  pdu CanFd_HvPowertrainStatus: length=16
    mapping Map_PackVoltageV: start-position=0, length=16, i-signal=Sig_PackVoltageV
    mapping Map_PackCurrentA: start-position=16, length=16, i-signal=Sig_PackCurrentA
    mapping Map_StateOfChargePct: start-position=32, length=16, i-signal=Sig_StateOfChargePct
    mapping Map_MaxDischargePowerKw: start-position=48, length=16, i-signal=Sig_MaxDischargePowerKw
