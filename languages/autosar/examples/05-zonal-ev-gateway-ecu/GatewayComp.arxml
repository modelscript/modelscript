AUTOSAR XML
package /EvGateway
  composition sw component type ZonalEvGatewayComposition
    component BmsMgr: type=BmsManagerSwc
    component TractionInv: type=TractionInverterSwc
    connect {context-component=BmsMgr, target-p-port=PowerLimitsOut} -> {context-component=TractionInv, target-r-port=PowerLimitsIn}
