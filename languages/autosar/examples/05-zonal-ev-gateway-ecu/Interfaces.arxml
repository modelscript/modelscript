AUTOSAR XML
package /EvInterfaces
  sender receiver interface HvBatteryLimitsIf
    data MaxDischargePowerKw
    data PackVoltageV
    data StateOfChargePct
